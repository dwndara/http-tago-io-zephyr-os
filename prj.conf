## prj.conf
```kconfig
# App stack
CONFIG_MAIN_STACK_SIZE=4096

# C Library
# Default use minimal libc and with COMMON_LIBC_MALLOC_ARENA_SIZE defining
# HEAP size (512 bytes) are enough to run DNS.
CONFIG_MINIMAL_LIBC_MALLOC_ARENA_SIZE=4096

CONFIG_WIFI=y
# WiFi offload drivers don't resolve DNS, so use manual IP
CONFIG_TAGOIO_MANUAL_SERVER=y
CONFIG_TAGOIO_HTTP_WIFI_SSID="REDE_TEST"
CONFIG_TAGOIO_HTTP_WIFI_PSK="REDE_TEST"

CONFIG_NET_CONFIG_SETTINGS=y
CONFIG_NET_DHCPV4=y

# Networking config
CONFIG_NETWORKING=y
CONFIG_NET_IPV4=y
CONFIG_NET_IPV6=n
CONFIG_NET_TCP=y
CONFIG_NET_SHELL=y

# Sockets
CONFIG_NET_SOCKETS=y
CONFIG_NET_SOCKETS_POLL_MAX=4

# Network driver config
CONFIG_TEST_RANDOM_GENERATOR=y

# Network address config
CONFIG_NET_CONFIG_NEED_IPV4=y
CONFIG_NET_DHCPV4=y
CONFIG_NET_CONFIG_INIT_TIMEOUT=1
CONFIG_NET_CONFIG_MY_IPV4_ADDR="192.168.0.69"
CONFIG_NET_CONFIG_MY_IPV4_GW="192.168.0.1"

# Resolver
CONFIG_DNS_RESOLVER=y

# HTTP
CONFIG_HTTP_CLIENT=y

# Network debug config
CONFIG_LOG=y
CONFIG_NET_LOG=y
CONFIG_NET_SOCKETS_LOG_LEVEL_DBG=n
CONFIG_NET_HTTP_LOG_LEVEL_DBG=n

# TagoIO API
CONFIG_TAGOIO_DEVICE_TOKEN="c077b662-cf21-480d-91ca-4b3d503a7d4e"
CONFIG_CBPRINTF_FP_SUPPORT=y
#Avoid Errors
CONFIG_NET_L2_ETHERNET=y
```

## src/main.c
```c
/*
 * Copyright (c) 2020 Gerson Fernando Budke <nandojve@gmail.com>
 *
 * SPDX-License-Identifier: Apache-2.0
 */

#include <zephyr/logging/log.h>
LOG_MODULE_REGISTER(tagoio_http_post, CONFIG_TAGOIO_HTTP_POST_LOG_LEVEL);

#include <zephyr/kernel.h>
#include <zephyr/net/socket.h>
#include <zephyr/net/http/client.h>
#include <zephyr/random/rand32.h>
#include <stdio.h>

#include "wifi.h"
#include "sockets.h"

static struct tagoio_context ctx;

static void response_cb(struct http_response *rsp,
												enum http_final_call final_data,
												void *user_data)
{
	if (final_data == HTTP_DATA_MORE)
	{
		LOG_DBG("Partial data received (%zd bytes)", rsp->data_len);
	}
	else if (final_data == HTTP_DATA_FINAL)
	{
		LOG_DBG("All the data received (%zd bytes)", rsp->data_len);
	}

	LOG_DBG("Response status %s", rsp->http_status);
}

#define LOWER_LIGHT 100
#define UPPER_LIGHT 1000
#define BASE_LIGHT 1.00f

static int collect_light_data(void)
{
	float light;

	/* Gera um valor de luminosidade entre 100 e 1000 lux */
	light = ((sys_rand32_get() % (UPPER_LIGHT - LOWER_LIGHT + 1)) + LOWER_LIGHT);
	light /= BASE_LIGHT;

	(void)snprintf(ctx.payload, sizeof(ctx.payload),
								 "{\"variable\": \"luminosity\","
								 "\"unit\": \"lux\",\"value\": %f}",
								 (double)light);

	/* LOG não imprime float diretamente #18351 */
	LOG_INF("Luminosity: %d lux", (int)light);

	return 0;
}

#define lower 20000
#define upper 100000
#define base 1000.00f

static int collect_data(void)
{
	float temp;

	/* Generate a temperature between 20 and 100 celsius degree */
	temp = ((sys_rand32_get() % (upper - lower + 1)) + lower);
	temp /= base;

	(void)snprintf(ctx.payload, sizeof(ctx.payload),
								 "{\"variable\": \"temperature\","
								 "\"unit\": \"c\",\"value\": %f}",
								 (double)temp);

	/* LOG doesn't print float #18351 */
	LOG_INF("Temp: %d C", (int)temp);

	return 0;
}

static void next_turn(void)
{
	/* Collect temperature data */
	if (collect_data() < 0)
	{
		LOG_INF("Error collecting temperature data.");
		return;
	}

	if (tagoio_connect(&ctx) < 0)
	{
		LOG_INF("No connection available.");
		return;
	}

	if (tagoio_http_push(&ctx, response_cb) < 0)
	{
		LOG_INF("Error pushing temperature data.");
		return;
	}

	k_sleep(K_SECONDS(1)); // Sleep for a second before collecting the next data

	/* Collect luminosity data */
	if (collect_light_data() < 0)
	{
		LOG_INF("Error collecting light data.");
		return;
	}

	if (tagoio_connect(&ctx) < 0)
	{
		LOG_INF("No connection available.");
		return;
	}

	if (tagoio_http_push(&ctx, response_cb) < 0)
	{
		LOG_INF("Error pushing light data.");
		return;
	}
}

void main(void)
{
	LOG_INF("TagoIO IoT - HTTP Client - Sensor Data Demo");

	wifi_connect();

	while (true)
	{
		next_turn();
		k_sleep(K_SECONDS(CONFIG_TAGOIO_HTTP_PUSH_INTERVAL));
	}
}
```

## src/sockets.c
```c
/*
 * Copyright (c) 2020 Gerson Fernando Budke <nandojve@gmail.com>
 *
 * SPDX-License-Identifier: Apache-2.0
 */

#include <zephyr/logging/log.h>
LOG_MODULE_DECLARE(tagoio_http_post, CONFIG_TAGOIO_HTTP_POST_LOG_LEVEL);

#include <zephyr/net/net_ip.h>
#include <zephyr/net/socket.h>
#include <zephyr/net/socketutils.h>
#include <zephyr/net/dns_resolve.h>
#include <zephyr/net/tls_credentials.h>
#include <zephyr/net/http/client.h>

#include "sockets.h"

#if defined(CONFIG_TAGOIO_MANUAL_SERVER)
#define TAGOIO_SERVER CONFIG_TAGOIO_API_SERVER_IP
#else
#define TAGOIO_SERVER "api.tago.io"
#endif

#define TAGOIO_URL "/data"
#define HTTP_PORT "80"

static const char *tagoio_http_headers[] = {
		"Device-Token: " CONFIG_TAGOIO_DEVICE_TOKEN "\r\n",
		"Content-Type: application/json\r\n",
		"_ssl: false\r\n",
		NULL};

int tagoio_connect(struct tagoio_context *ctx)
{
	struct addrinfo *addr;
	struct addrinfo hints;
	char hr_addr[INET6_ADDRSTRLEN];
	char *port;
	int dns_attempts = 3;
	int ret = -1;

	memset(&hints, 0, sizeof(hints));

	hints.ai_socktype = SOCK_STREAM;
	hints.ai_protocol = IPPROTO_TCP;
	if (IS_ENABLED(CONFIG_NET_IPV6))
	{
		hints.ai_family = AF_INET6;
	}
	else if (IS_ENABLED(CONFIG_NET_IPV4))
	{
		hints.ai_family = AF_INET;
	}
	port = HTTP_PORT;

	while (dns_attempts--)
	{
		ret = getaddrinfo(TAGOIO_SERVER, port, &hints, &addr);
		if (ret == 0)
		{
			break;
		}
		k_sleep(K_SECONDS(1));
	}

	if (ret < 0)
	{
		LOG_ERR("Could not resolve dns, error: %d", ret);
		return ret;
	}

	LOG_DBG("%s address: %s",
					(addr->ai_family == AF_INET ? "IPv4" : "IPv6"),
					net_addr_ntop(addr->ai_family,
												&net_sin(addr->ai_addr)->sin_addr,
												hr_addr, sizeof(hr_addr)));

	ctx->sock = socket(hints.ai_family,
										 hints.ai_socktype,
										 hints.ai_protocol);
	if (ctx->sock < 0)
	{
		LOG_ERR("Failed to create %s HTTP socket (%d)",
						(addr->ai_family == AF_INET ? "IPv4" : "IPv6"),
						-errno);

		freeaddrinfo(addr);
		return -errno;
	}

	if (connect(ctx->sock, addr->ai_addr, addr->ai_addrlen) < 0)
	{
		LOG_ERR("Cannot connect to %s remote (%d)",
						(addr->ai_family == AF_INET ? "IPv4" : "IPv6"),
						-errno);

		freeaddrinfo(addr);
		return -errno;
	}

	freeaddrinfo(addr);

	return 0;
}

int tagoio_http_push(struct tagoio_context *ctx,
										 http_response_cb_t resp_cb)
{
	struct http_request req;
	int ret;

	memset(&req, 0, sizeof(req));

	req.method = HTTP_POST;
	req.host = TAGOIO_SERVER;
	req.port = HTTP_PORT;
	req.url = TAGOIO_URL;
	req.header_fields = tagoio_http_headers;
	req.protocol = "HTTP/1.1";
	req.response = resp_cb;
	req.payload = ctx->payload;
	req.payload_len = strlen(ctx->payload);
	req.recv_buf = ctx->resp;
	req.recv_buf_len = sizeof(ctx->resp);

	ret = http_client_req(ctx->sock, &req,
												CONFIG_TAGOIO_HTTP_CONN_TIMEOUT * MSEC_PER_SEC,
												ctx);

	close(ctx->sock);
	ctx->sock = -1;

	return ret;
}
```

## src/wifi.c
```c
/*
 * Copyright (c) 2020 Gerson Fernando Budke <nandojve@gmail.com>
 *
 * SPDX-License-Identifier: Apache-2.0
 */

#include <zephyr/logging/log.h>
LOG_MODULE_DECLARE(tagoio_http_post, CONFIG_TAGOIO_HTTP_POST_LOG_LEVEL);

#include <zephyr/net/wifi_mgmt.h>

static int connected;
static struct net_mgmt_event_callback wifi_shell_mgmt_cb;

static void handle_wifi_connect_result(struct net_mgmt_event_callback *cb)
{
	const struct wifi_status *status = (const struct wifi_status *)
																				 cb->info;

	if (status->status)
	{
		LOG_ERR("Connection request failed (%d)", status->status);
	}
	else
	{
		LOG_INF("WIFI Connected");
		connected = 1;
	}
}

static void wifi_mgmt_event_handler(struct net_mgmt_event_callback *cb,
																		uint32_t mgmt_event, struct net_if *iface)
{
	switch (mgmt_event)
	{
	case NET_EVENT_WIFI_CONNECT_RESULT:
		handle_wifi_connect_result(cb);
		break;
	default:
		break;
	}
}

void wifi_connect(void)
{
	int nr_tries = 10;
	int ret = 0;

	net_mgmt_init_event_callback(&wifi_shell_mgmt_cb,
															 wifi_mgmt_event_handler,
															 NET_EVENT_WIFI_CONNECT_RESULT);

	net_mgmt_add_event_callback(&wifi_shell_mgmt_cb);

	struct net_if *iface = net_if_get_default();
	while (!net_if_is_up(iface))
	{
		k_sleep(K_MSEC(100));
	}

	static struct wifi_connect_req_params cnx_params = {
			.ssid = CONFIG_TAGOIO_HTTP_WIFI_SSID,
			.ssid_length = 0,
			.psk = CONFIG_TAGOIO_HTTP_WIFI_PSK,
			.psk_length = 0,
			.channel = 0,
			.security = WIFI_SECURITY_TYPE_PSK,
	};

	cnx_params.ssid_length = strlen(CONFIG_TAGOIO_HTTP_WIFI_SSID);
	cnx_params.psk_length = strlen(CONFIG_TAGOIO_HTTP_WIFI_PSK);

	connected = 0;

	LOG_INF("WIFI try connecting to %s...", CONFIG_TAGOIO_HTTP_WIFI_SSID);

	/* Let's wait few seconds to allow wifi device be on-line */
	while (nr_tries-- > 0)
	{
		ret = net_mgmt(NET_REQUEST_WIFI_CONNECT, iface, &cnx_params,
									 sizeof(struct wifi_connect_req_params));
		if (ret == 0)
		{
			break;
		}

		LOG_INF("Connect request failed %d. Waiting iface be up...", ret);
		k_msleep(500);
	}

	while (connected == 0)
	{
		k_msleep(100);
	}
}
```
